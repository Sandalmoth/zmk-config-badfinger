## config/boards/shields/badfinger/Kconfig.defconfig
```kconfig
if SHIELD_BADFINGER_LEFT

config ZMK_KEYBOARD_NAME
    default "badfinger"

config ZMK_SPLIT_ROLE_CENTRAL
    default y

endif

if SHIELD_BADFINGER_LEFT || SHIELD_BADFINGER_RIGHT

config ZMK_SPLIT
    default y

endif
```

## config/boards/shields/badfinger/Kconfig.shield
```kconfig
config SHIELD_BADFINGER_LEFT
    def_bool $(shields_list_contains,badfinger_left)
    
config SHIELD_BADFINGER_RIGHT
    def_bool $(shields_list_contains,badfinger_right)
```
